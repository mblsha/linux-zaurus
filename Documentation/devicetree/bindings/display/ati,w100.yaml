## drivers/soc/pxa/Kconfig
```kconfig
# SPDX-License-Identifier: GPL-2.0-only
config PLAT_PXA
	bool

config PXA_SSP
	tristate
	help
	  Enable support for PXA2xx SSP ports

config PXA_DRIVER_KUNIT_TEST
	tristate "KUnit tests for PXA driver policies" if !KUNIT_ALL_TESTS
	depends on KUNIT
	default KUNIT_ALL_TESTS
	help
	  Regression and happy-path tests for the audited PXA driver contracts.
	  The suite covers FICP, UART, audio, GPIO, I2C, RTC, UDC, SPI, DMA,
	  PCMCIA, CPU-frequency transitions, camera, GCU, OHCI, and PXA168
	  Ethernet, including fake-MMIO and lifecycle fault injection.
```

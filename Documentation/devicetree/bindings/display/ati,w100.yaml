## Documentation/devicetree/bindings/display/ati,w100.yaml
```yaml
# SPDX-License-Identifier: (GPL-2.0-only OR BSD-2-Clause)
%YAML 1.2
---
$id: http://devicetree.org/schemas/display/ati,w100.yaml#
$schema: http://devicetree.org/meta-schemas/core.yaml#

title: ATI Imageon W100 display controller

maintainers:
  - Michael Pishchagin <mblsha+gh@gmail.com>

description:
  The Imageon W100 is a memory-mapped display controller used by early
  handheld systems. Board-specific register and mode tables are selected by
  the compatible string and remain in the driver.

properties:
  compatible:
    items:
      - const: sharp,sl-c860-w100
      - const: ati,w100

  reg:
    maxItems: 1

required:
  - compatible
  - reg

additionalProperties: false

examples:
  - |
    display-controller@8000000 {
        compatible = "sharp,sl-c860-w100", "ati,w100";
        reg = <0x08000000 0x01000000>;
    };
```

## Documentation/devicetree/bindings/display/sharp,sl-c860-lcd-controller.yaml
```yaml
# SPDX-License-Identifier: (GPL-2.0-only OR BSD-2-Clause)
%YAML 1.2
---
$id: http://devicetree.org/schemas/display/sharp,sl-c860-lcd-controller.yaml#
$schema: http://devicetree.org/meta-schemas/core.yaml#

title: Sharp SL-C860 LCD timing and backlight controller

maintainers:
  - Zaurus Linux maintainers <zaurus-lab@localhost>

allOf:
  - $ref: /schemas/spi/spi-peripheral-props.yaml#

properties:
  compatible:
    const: sharp,sl-c860-lcd-controller

  reg:
    maxItems: 1

  backlight-control-gpios:
    maxItems: 1

  sharp,common-voltage-adjust:
    $ref: /schemas/types.yaml#/definitions/uint32
    maximum: 255
    description:
      Raw 8-bit common-voltage DAC adjustment. This provides a deterministic
      fallback when the bootloader does not preserve the Sharp factory
      parameter block in RAM.

  sharp,phase-adjust:
    $ref: /schemas/types.yaml#/definitions/uint32
    maximum: 15
    description:
      Four-bit LCD input sampling phase adjustment. This provides a
      deterministic fallback when the bootloader does not preserve the Sharp
      factory parameter block in RAM.

  spi-max-frequency:
    maximum: 50000

required:
  - compatible
  - reg
  - backlight-control-gpios

  - spi-max-frequency

unevaluatedProperties: false
```

## Documentation/devicetree/bindings/gpio/sharp,scoop.yaml
```yaml
# SPDX-License-Identifier: (GPL-2.0-only OR BSD-2-Clause)
%YAML 1.2
---
$id: http://devicetree.org/schemas/gpio/sharp,scoop.yaml#
$schema: http://devicetree.org/meta-schemas/core.yaml#

title: Sharp SCOOP system controller GPIO block

maintainers:
 - Zaurus Lab <zaurus-lab@localhost>

description: |
 SCOOP is a companion system controller used by Sharp Zaurus handhelds.  It
 exposes twelve GPIO lines and also participates in PCMCIA power, board
 restart, and system-suspend sequencing.  GPIO line zero corresponds to
 SCOOP register bit one; register bit zero is not a GPIO.

properties:
 compatible:
   oneOf:
     - items:
         - const: sharp,sl-c860-scoop
         - const: sharp,scoop
     - const: sharp,scoop

 reg:
   maxItems: 1

 gpio-controller: true

 '#gpio-cells':
   const: 2

 gpio-line-names:
   minItems: 1
   maxItems: 12

 sharp,io-direction-mask:
   $ref: /schemas/types.yaml#/definitions/uint32
   maximum: 65535
   description: |
     Initial SCOOP GPCR value.  Set bits configure outputs and clear bits
     configure inputs.  Bits one through twelve correspond to GPIO lines
     zero through eleven.

 sharp,io-output-mask:
   $ref: /schemas/types.yaml#/definitions/uint32
   maximum: 65535
   description: Initial SCOOP GPWR output value.

 sharp,suspend-clear-mask:
   $ref: /schemas/types.yaml#/definitions/uint32
   maximum: 65535
   description: GPIO output bits cleared while the controller is suspended.

 sharp,suspend-set-mask:
   $ref: /schemas/types.yaml#/definitions/uint32
   maximum: 65535
   description: GPIO output bits set while the controller is suspended.

required:
 - compatible
 - reg
 - gpio-controller
 - '#gpio-cells'
 - sharp,io-direction-mask
 - sharp,io-output-mask
 - sharp,suspend-clear-mask
 - sharp,suspend-set-mask

unevaluatedProperties: false

examples:
 - |
   system-controller@10800000 {
       compatible = "sharp,sl-c860-scoop", "sharp,scoop";
       reg = <0x10800000 0x1000>;
       gpio-controller;
       #gpio-cells = <2>;
       gpio-line-names = "mail-led", "hinge-a", "hinge-b",
                         "audio-mute-left", "audio-mute-right",
                         "accessory-pullup", "audio-amplifier",
                         "backlight", "microphone-bias", "", "", "";
       sharp,io-direction-mask = <0x03f2>;
       sharp,io-output-mask = <0x0030>;
       sharp,suspend-clear-mask = <0xffff>;
       sharp,suspend-set-mask = <0x0000>;
   };
...
```

## Documentation/devicetree/bindings/hwmon/maxim,max1111.yaml
```yaml
# SPDX-License-Identifier: (GPL-2.0-only OR BSD-2-Clause)
%YAML 1.2
---
$id: http://devicetree.org/schemas/hwmon/maxim,max1111.yaml#
$schema: http://devicetree.org/meta-schemas/core.yaml#

title: Maxim MAX1110/MAX1111/MAX1112/MAX1113 ADC

maintainers:
  - Zaurus Linux maintainers <zaurus-lab@localhost>

allOf:
  - $ref: /schemas/spi/spi-peripheral-props.yaml#

properties:
  compatible:
    enum:
      - maxim,max1110
      - maxim,max1111
      - maxim,max1112
      - maxim,max1113

  reg:
    maxItems: 1

  spi-max-frequency: true

required:
  - compatible
  - reg

  - spi-max-frequency

unevaluatedProperties: false
```

## Documentation/devicetree/bindings/input/gpio-matrix-keypad.txt
```
* GPIO driven matrix keypad device tree bindings

GPIO driven matrix keypad is used to interface a SoC with a matrix keypad.
The matrix keypad supports multiple row and column lines, a key can be
placed at each intersection of a unique row and a unique column. The matrix
keypad can sense a key-press and key-release by means of GPIO lines and
report the event using GPIO interrupts to the cpu.

Required Properties:
- compatible:		Should be "gpio-matrix-keypad"
- row-gpios:		List of gpios used as row lines. The gpio specifier
			for this property depends on the gpio controller to
			which these row lines are connected.
- col-gpios:		List of gpios used as column lines. The gpio specifier
			for this property depends on the gpio controller to
			which these column lines are connected.
- linux,keymap:		The definition can be found at
			bindings/input/matrix-keymap.txt

Optional Properties:
- linux,no-autorepeat:	do no enable autorepeat feature.
- wakeup-source:	use any event on keypad as wakeup event.
			(Legacy property supported: "linux,wakeup")
- debounce-delay-ms:	debounce interval in milliseconds
- col-scan-delay-us:	delay, measured in microseconds, that is needed
			before we can scan keypad after activating column gpio
- drive-inactive-cols:	drive inactive columns during scan,
			default is to turn inactive columns into inputs.
- linux,fn-key:		Two cells identifying the row and column of an Fn
			modifier key. Must be paired with linux,fn-keymap.
- linux,fn-keymap:	A sparse secondary matrix keymap selected while the
			Fn key is held. Its entries use the same packed format as
			linux,keymap. The selected keycode remains latched until
			the physical key is released.

Example:
	matrix-keypad {
		compatible = "gpio-matrix-keypad";
		debounce-delay-ms = <5>;
		col-scan-delay-us = <2>;

		row-gpios = <&gpio2 25 0
			     &gpio2 26 0
			     &gpio2 27 0>;

		col-gpios = <&gpio2 21 0
			     &gpio2 22 0>;

		linux,keymap = <0x0000008B
				0x0100009E
				0x02000069
				0x0001006A
				0x0101001C
				0x0201006C>;

		linux,fn-key = <2 0>;
		linux,fn-keymap = <0x000000AE>;
	};
```

## Documentation/devicetree/bindings/input/gpio-matrix-keypad.yaml
```yaml
# SPDX-License-Identifier: (GPL-2.0-only OR BSD-2-Clause)
%YAML 1.2
---

$id: http://devicetree.org/schemas/input/gpio-matrix-keypad.yaml#
$schema: http://devicetree.org/meta-schemas/core.yaml#

title: GPIO matrix keypad

maintainers:
  - Marek Vasut <marek.vasut@gmail.com>

description:
  GPIO driven matrix keypad is used to interface a SoC with a matrix keypad.
  The matrix keypad supports multiple row and column lines, a key can be
  placed at each intersection of a unique row and a unique column. The matrix
  keypad can sense a key-press and key-release by means of GPIO lines and
  report the event using GPIO interrupts to the cpu.

allOf:
  - $ref: /schemas/input/matrix-keymap.yaml#

properties:
  compatible:
    const: gpio-matrix-keypad

  row-gpios:
    description:
      List of GPIOs used as row lines. The gpio specifier for this property
      depends on the gpio controller to which these row lines are connected.

  col-gpios:
    description:
      List of GPIOs used as column lines. The gpio specifier for this property
      depends on the gpio controller to which these column lines are connected.

  linux,keymap: true

  linux,fn-key:
    $ref: /schemas/types.yaml#/definitions/uint32-array
    minItems: 2
    maxItems: 2
    description:
      Matrix row and column of an Fn modifier key. Must be paired with
      linux,fn-keymap.

  linux,fn-keymap:
    $ref: /schemas/types.yaml#/definitions/uint32-array
    description:
      Sparse secondary matrix keymap selected while the Fn key is held. The
      selected keycode remains latched until the physical key is released.

  linux,no-autorepeat:
    type: boolean
    description: Do not enable autorepeat feature.

  gpio-activelow:
    type: boolean
    description:
      Force GPIO polarity to active low.
      In the absence of this property GPIOs are treated as active high.

  debounce-delay-ms:
    description: Debounce interval in milliseconds.
    default: 0

  col-scan-delay-us:
    description:
      Delay, measured in microseconds, that is needed
      before we can scan keypad after activating column gpio.
    default: 0

  all-cols-on-delay-us:
    description:
      Delay, measured in microseconds, that is needed
      after activating all column gpios.
    default: 0

  drive-inactive-cols:
    type: boolean
    description:
      Drive inactive columns during scan,
      default is to turn inactive columns into inputs.

  wakeup-source: true

required:
  - compatible
  - row-gpios
  - col-gpios
  - linux,keymap

dependentRequired:
  linux,fn-key: [ linux,fn-keymap ]
  linux,fn-keymap: [ linux,fn-key ]

additionalProperties: false

examples:
  - |
    matrix-keypad {
        compatible = "gpio-matrix-keypad";
        debounce-delay-ms = <5>;
        col-scan-delay-us = <2>;

        row-gpios = <&gpio2 25 0
                     &gpio2 26 0
                     &gpio2 27 0>;

        col-gpios = <&gpio2 21 0
                     &gpio2 22 0>;

        linux,keymap = <0x0000008B
                        0x0100009E
                        0x02000069
                        0x0001006A
                        0x0101001C
                        0x0201006C>;

        linux,fn-key = <2 0>;
        linux,fn-keymap = <0x000000AE>;

        wakeup-source;
    };
```

## Documentation/devicetree/bindings/misc/marvell,pxa25x-ficp.yaml
```yaml
# SPDX-License-Identifier: (GPL-2.0-only OR BSD-2-Clause)
%YAML 1.2
---
$id: http://devicetree.org/schemas/misc/marvell,pxa25x-ficp.yaml#
$schema: http://devicetree.org/meta-schemas/core.yaml#

title: Marvell PXA25x fast infrared communication port

maintainers:
  - Robert Jarzmik <robert.jarzmik@free.fr>

description: |
  The PXA25x fast infrared communication port shares the standard UART pins
  and infrared-selection register when it operates in SIR mode. Linux no
  longer provides the IrDA protocol stack, so the current driver exposes a
  bounded hardware diagnostic interface only.

properties:
  compatible:
    const: marvell,pxa25x-ficp

  reg:
    items:
      - description: Fast infrared communication port registers
      - description: Standard UART registers used for SIR selection

  reg-names:
    items:
      - const: ficp
      - const: stuart

  interrupts:
    maxItems: 1

  clocks:
    items:
      - description: Fast infrared communication port clock
      - description: Standard UART clock used for SIR mode

  clock-names:
    items:
      - const: ficp
      - const: stuart

  powerdown-gpios:
    description: GPIO that powers down the external infrared transceiver
    maxItems: 1

required:
  - compatible
  - reg
  - reg-names
  - interrupts
  - clocks
  - clock-names

additionalProperties: false

examples:
  - |
    #include <dt-bindings/clock/pxa-clock.h>
    #include <dt-bindings/gpio/gpio.h>

    serial@40800000 {
        compatible = "marvell,pxa25x-ficp";
        reg = <0x40800000 0x24>, <0x40700000 0x24>;
        reg-names = "ficp", "stuart";
        interrupts = <19>;
        clocks = <&clks CLK_FICP>, <&clks CLK_STUART>;
        clock-names = "ficp", "stuart";
        powerdown-gpios = <&gpio 22 GPIO_ACTIVE_HIGH>;
    };
```

## Documentation/devicetree/bindings/mtd/sharp,sl-c860-nand.yaml
```yaml
# SPDX-License-Identifier: (GPL-2.0-only OR BSD-2-Clause)
%YAML 1.2
---
$id: http://devicetree.org/schemas/mtd/sharp,sl-c860-nand.yaml#
$schema: http://devicetree.org/meta-schemas/core.yaml#

title: Sharp Zaurus SL-C860 NAND controller

maintainers:
  - Mikhail Shalabin <mblsha@gmail.com>

description: |
  The SL-C860 exposes a small-page NAND device through Sharp's memory-mapped
  ECC and flash-control block on PXA chip select 3. The controller provides
  one-bit Hamming ECC per 256-byte step. The current Device Tree driver path
  is intentionally read-only at the master MTD level for preservation and
  geometry qualification; legacy platform-data users are unchanged.

allOf:
  - $ref: nand-controller.yaml#

properties:
  compatible:
    const: sharp,sl-c860-nand

  reg:
    maxItems: 1

required:
  - compatible
  - reg

unevaluatedProperties: false

examples:
  - |
    nand-controller@c000000 {
        compatible = "sharp,sl-c860-nand";
        reg = <0x0c000000 0x1000>;
        #address-cells = <1>;
        #size-cells = <0>;

        nand@0 {
            reg = <0>;
            nand-ecc-step-size = <256>;
            nand-ecc-strength = <1>;

            partitions {
                compatible = "fixed-partitions";
                #address-cells = <1>;
                #size-cells = <1>;

                partition@0 {
                    label = "bootstrap";
                    reg = <0x00000000 0x00700000>;
                    read-only;
                };
            };
        };
    };
...
```

## Documentation/devicetree/bindings/pcmcia/sharp,sl-c860-pcmcia.yaml
```yaml
# SPDX-License-Identifier: (GPL-2.0-only OR BSD-2-Clause)
%YAML 1.2
---
$id: http://devicetree.org/schemas/pcmcia/sharp,sl-c860-pcmcia.yaml#
$schema: http://devicetree.org/meta-schemas/core.yaml#

title: Sharp Zaurus SL-C860 CompactFlash socket

maintainers:
 - Zaurus Lab <zaurus-lab@localhost>

description: |
 The SL-C860 exposes one 16-bit PCMCIA-compatible CompactFlash socket through
 the PXA25x static-memory controller.  A Sharp SCOOP companion controller
 implements card power, reset, voltage sensing, and socket status.  Direct
 PXA GPIOs provide card detect and the card interrupt.

properties:
 compatible:
   const: sharp,sl-c860-pcmcia

 reg:
   maxItems: 1

 interrupts-extended:
   maxItems: 1
   description: CompactFlash card interrupt.

 cd-gpios:
   maxItems: 1
   description: Active-low card-detect input.

 sharp,scoop:
   $ref: /schemas/types.yaml#/definitions/phandle
   description: SCOOP controller implementing the socket-control registers.

 pinctrl-names:
   items:
     - const: default

 pinctrl-0: true

required:
 - compatible
 - reg
 - interrupts-extended
 - cd-gpios
 - sharp,scoop

additionalProperties: false

examples:
 - |
   pcmcia@20000000 {
       compatible = "sharp,sl-c860-pcmcia";
       reg = <0x20000000 0x10000000>;
       cd-gpios = <&gpio 14 1>;
       interrupts-extended = <&gpio 17 3>;
       sharp,scoop = <&scoop>;
   };
...
```

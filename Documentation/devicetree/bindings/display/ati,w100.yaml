## Documentation/devicetree/bindings/power/reset/sharp,sl-c860-sys-off.yaml
```yaml
# SPDX-License-Identifier: (GPL-2.0-only OR BSD-2-Clause)
%YAML 1.2
---
$id: http://devicetree.org/schemas/power/reset/sharp,sl-c860-sys-off.yaml#
$schema: http://devicetree.org/meta-schemas/core.yaml#

title: Sharp SL-C860 bootloader system-off selection

maintainers:
  - Zaurus Lab <zaurus-lab@localhost>

description: |
  The SL-C860 bootloader samples the green mail LED output after a watchdog
  reset. A low output requests halt and a high output requests another boot.
  The referenced LED remains a normal LED class device during runtime.

properties:
  compatible:
    const: sharp,sl-c860-sys-off

  leds:
    maxItems: 1
    description: Green mail LED sampled by the bootloader.

required:
  - compatible
  - leds

additionalProperties: false

examples:
  - |
    system-off {
        compatible = "sharp,sl-c860-sys-off";
        leds = <&mail_led>;
    };
...
```

## Documentation/devicetree/bindings/power/supply/sharp,sl-c860-power.yaml
```yaml
# SPDX-License-Identifier: (GPL-2.0-only OR BSD-2-Clause)
%YAML 1.2
---
$id: http://devicetree.org/schemas/power/supply/sharp,sl-c860-power.yaml#
$schema: http://devicetree.org/meta-schemas/core.yaml#

title: Sharp SL-C860 battery and power controller

maintainers:
  - Zaurus Linux maintainers <zaurus-lab@localhost>

description: |
  GPIO and policy interface used by the SharpSL battery monitor and the
  PXA25x system-suspend implementation on the Sharp SL-C860.

properties:
  compatible:
    const: sharp,sl-c860-power

  temperature-enable-gpios:
    maxItems: 1

  charge-enable-gpios:
    maxItems: 1

  charge-unknown-gpios:
    maxItems: 1

  discharge-enable-gpios:
    maxItems: 1

  ac-present-gpios:
    maxItems: 1

  battery-full-gpios:
    maxItems: 1

  battery-cover-gpios:
    maxItems: 1

  key-wakeup-gpios:
    maxItems: 1

  power-wakeup-gpios:
    maxItems: 1

  sharp,charging-disabled:
    type: boolean
    description:
      Keep both charger-control outputs inactive. This fail-closed policy is
      required until charging has been qualified with representative hardware.

  wakeup-source: true

required:
  - compatible
  - temperature-enable-gpios
  - charge-enable-gpios
  - charge-unknown-gpios
  - discharge-enable-gpios
  - ac-present-gpios
  - battery-full-gpios
  - battery-cover-gpios
  - key-wakeup-gpios
  - power-wakeup-gpios
  - sharp,charging-disabled
  - wakeup-source

additionalProperties: false

examples:
  - |
    #include <dt-bindings/gpio/gpio.h>

    power-controller {
        compatible = "sharp,sl-c860-power";
        temperature-enable-gpios = <&gpio 21 GPIO_ACTIVE_HIGH>;
        charge-enable-gpios = <&gpio 38 GPIO_ACTIVE_HIGH>;
        charge-unknown-gpios = <&gpio 43 GPIO_ACTIVE_HIGH>;
        discharge-enable-gpios = <&gpio 42 GPIO_ACTIVE_HIGH>;
        ac-present-gpios = <&gpio 1 GPIO_ACTIVE_LOW>;
        battery-full-gpios = <&gpio 16 GPIO_ACTIVE_HIGH>;
        battery-cover-gpios = <&gpio 11 GPIO_ACTIVE_HIGH>;
        key-wakeup-gpios = <&gpio 0 GPIO_ACTIVE_LOW>;
        power-wakeup-gpios = <&gpio 3 GPIO_ACTIVE_LOW>;
        sharp,charging-disabled;
        wakeup-source;
    };
```

## Documentation/devicetree/bindings/sound/marvell,pxa25x-i2s.yaml
```yaml
# SPDX-License-Identifier: (GPL-2.0-only OR BSD-2-Clause)
%YAML 1.2
---
$id: http://devicetree.org/schemas/sound/marvell,pxa25x-i2s.yaml#
$schema: http://devicetree.org/meta-schemas/core.yaml#

title: Marvell PXA25x I2S controller

maintainers:
  - Michael Pishchagin <mblsha+gh@gmail.com>

properties:
  compatible:
    const: marvell,pxa25x-i2s

  reg:
    maxItems: 1

  interrupts:
    maxItems: 1

  clocks:
    maxItems: 1

  clock-names:
    items:
      - const: i2s

  dmas:
    items:
      - description: receive DMA channel
      - description: transmit DMA channel

  dma-names:
    items:
      - const: rx
      - const: tx

  '#sound-dai-cells':
    const: 0

required:
  - compatible
  - reg
  - interrupts
  - clocks
  - clock-names
  - '#sound-dai-cells'

additionalProperties: false

examples:
  - |
    #include <dt-bindings/clock/pxa-clock.h>
    audio-controller@40400000 {
        compatible = "marvell,pxa25x-i2s";
        reg = <0x40400000 0x84>;
        interrupts = <13>;
        clocks = <&clks CLK_I2S>;
        clock-names = "i2s";
        #sound-dai-cells = <0>;
    };
```

## Documentation/devicetree/bindings/sound/sharp,sl-c860-audio.yaml
```yaml
# SPDX-License-Identifier: (GPL-2.0-only OR BSD-2-Clause)
%YAML 1.2
---
$id: http://devicetree.org/schemas/sound/sharp,sl-c860-audio.yaml#
$schema: http://devicetree.org/meta-schemas/core.yaml#

title: Sharp Zaurus SL-C860 audio complex

maintainers:
  - Michael Pishchagin <mblsha+gh@gmail.com>

properties:
  compatible:
    const: sharp,sl-c860-audio

  i2s-controller:
    $ref: /schemas/types.yaml#/definitions/phandle

  audio-codec:
    $ref: /schemas/types.yaml#/definitions/phandle

  mute-l-gpios:
    maxItems: 1

  mute-r-gpios:
    maxItems: 1

  apm-on-gpios:
    maxItems: 1

  mic-bias-gpios:
    maxItems: 1

required:
  - compatible
  - i2s-controller
  - audio-codec
  - mute-l-gpios
  - mute-r-gpios
  - apm-on-gpios
  - mic-bias-gpios

additionalProperties: false

examples:
  - |
    #include <dt-bindings/gpio/gpio.h>
    sound {
        compatible = "sharp,sl-c860-audio";
        i2s-controller = <&i2s>;
        audio-codec = <&codec>;
        mute-l-gpios = <&scoop 3 GPIO_ACTIVE_HIGH>;
        mute-r-gpios = <&scoop 4 GPIO_ACTIVE_HIGH>;
        apm-on-gpios = <&scoop 6 GPIO_ACTIVE_HIGH>;
        mic-bias-gpios = <&scoop 8 GPIO_ACTIVE_HIGH>;
    };
```

## Documentation/devicetree/bindings/spi/marvell,pxa25x-spi.yaml
```yaml
# SPDX-License-Identifier: (GPL-2.0-only OR BSD-2-Clause)
%YAML 1.2
---
$id: http://devicetree.org/schemas/spi/marvell,pxa25x-spi.yaml#
$schema: http://devicetree.org/meta-schemas/core.yaml#

title: Marvell PXA25x SSP SPI controller

maintainers:
  - Zaurus Linux maintainers <zaurus-lab@localhost>

allOf:
  - $ref: spi-controller.yaml#

properties:
  compatible:
    const: marvell,pxa25x-spi

  reg:
    maxItems: 1

  interrupts:
    maxItems: 1

  clocks:
    maxItems: 1

  dmas:
    maxItems: 2

  dma-names:
    items:
      - const: rx
      - const: tx

required:
  - compatible
  - reg
  - interrupts
  - clocks

unevaluatedProperties: false

examples:
  - |
    spi@41000000 {
        compatible = "marvell,pxa25x-spi";
        reg = <0x41000000 0x20>;
        interrupts = <24>;
        clocks = <&clks 3>;
        #address-cells = <1>;
        #size-cells = <0>;
    };
```

## Documentation/devicetree/bindings/usb/marvell,pxa25x-udc.yaml
```yaml
# SPDX-License-Identifier: (GPL-2.0-only OR BSD-2-Clause)
%YAML 1.2
---
$id: http://devicetree.org/schemas/usb/marvell,pxa25x-udc.yaml#
$schema: http://devicetree.org/meta-schemas/core.yaml#

title: Marvell PXA25x USB device controller

maintainers:
  - Robert Jarzmik <robert.jarzmik@free.fr>

properties:
  compatible:
    const: marvell,pxa25x-udc

  reg:
    maxItems: 1

  interrupts:
    maxItems: 1

  clocks:
    maxItems: 1

  pullup-gpios:
    description: GPIO controlling the USB D+ pull-up
    maxItems: 1

required:
  - compatible
  - reg
  - interrupts
  - clocks

additionalProperties: false

examples:
  - |
    #include <dt-bindings/clock/pxa-clock.h>
    #include <dt-bindings/gpio/gpio.h>

    usb@40600000 {
        compatible = "marvell,pxa25x-udc";
        reg = <0x40600000 0x10000>;
        interrupts = <11>;
        clocks = <&clks CLK_UDC>;
        pullup-gpios = <&gpio 45 GPIO_ACTIVE_HIGH>;
    };
```

## arch/arm/mach-pxa/Kconfig
```kconfig
# SPDX-License-Identifier: GPL-2.0-only
menuconfig ARCH_PXA
	bool "PXA2xx/PXA3xx-based"
	depends on ARCH_MULTI_V5
	depends on CPU_LITTLE_ENDIAN
	select ARM_CPU_SUSPEND if PM
	select CLKSRC_PXA
	select CLKSRC_MMIO
	select TIMER_OF
	select CPU_XSCALE if !CPU_XSC3
	select GPIO_PXA
	select GPIOLIB
	select PLAT_PXA
	help
	  Support for Intel/Marvell's PXA2xx/PXA3xx processor line.

if ARCH_PXA

config MACH_PXA25X_DT
	bool "Support PXA25x platforms from device tree"
	select PINCTRL
	select POWER_SUPPLY
	select PXA25x
	select USE_OF
	help
	  Include support for Marvell PXA25x based platforms using
	  the device tree. Needn't select any other machine while
	  MACH_PXA25x_DT is enabled.

config MACH_SHARP_SL_C860_DT
	bool "Support the Sharp Zaurus SL-C860 from device tree"
	select LEDS_CLASS
	select LEDS_GPIO
	select MACH_PXA25X_DT
	select NEW_LEDS
	select POWER_RESET
	select POWER_RESET_SHARP_SL_C860
	select PXA_SHARPSL
	select SHARPSL_PM
	help
	  Include support for the Sharp Zaurus SL-C860 using its complete
	  Device Tree hardware description. Legacy Corgi-family board files
	  are not required or registered by this configuration.

config SHARP_SL_C860_DEEP_RESUME
	bool "Enable the qualified Sharp SL-C860 deep-resume path"
	depends on MACH_SHARP_SL_C860_DT
	depends on PXA25x && !PXA27x
	depends on !VMAP_STACK
	help
	  Enable the physically qualified SL-C860/PXA255 suspend and resume
	  contract. This reserves the first 4 KiB of SDRAM for a stackless
	  resume trampoline, uses the Sharp PXA255 sleep tail and board GPIO
	  state, and validates the stock keyboard and RTC wake policies.

	  The implementation is runtime-gated to the "sharp,sl-c860" Device
	  Tree compatible. Other PXA25x machines in a multi-platform kernel
	  keep the generic suspend path.

	  This path currently requires a directly mapped kernel stack because
	  that is the configuration qualified on physical SL-C860 hardware.

config MACH_PXA27X_DT
	bool "Support PXA27x platforms from device tree"
	select PINCTRL
	select POWER_SUPPLY
	select PXA27x
	select USE_OF
	help
	  Include support for Marvell PXA27x based platforms using
	  the device tree. Needn't select any other machine while
	  MACH_PXA27X_DT is enabled.

config MACH_PXA3XX_DT
	bool "Support PXA3xx platforms from device tree"
	select CPU_PXA300
	select CPU_PXA310
	select CPU_PXA320
	select PINCTRL
	select POWER_SUPPLY
	select PXA3xx
	select USE_OF
	help
	  Include support for Marvell PXA3xx based platforms using
	  the device tree. Needn't select any other machine while
	  MACH_PXA3XX_DT is enabled.

config PXA_SHARPSL
	bool "Support shared Sharp Zaurus hardware"
	select SHARP_PARAM
	select SHARP_SCOOP
	help
	  Enable the drivers shared by Sharp Zaurus PXA machines, including
	  SCOOP and the Sharp parameter block. Device Tree and legacy board
	  configurations both use this common support.

if ATAGS

comment "Legacy board files"

config ARCH_GUMSTIX
	bool "Gumstix XScale 255 boards"
	select PXA25x
	help
	  Say Y here if you intend to run this kernel on
	  Basix, Connex, ws-200ax, ws-400ax systems

choice
	prompt "Gumstix Carrier/Expansion Board"
	depends on ARCH_GUMSTIX

config GUMSTIX_AM200EPD
	bool "Enable AM200EPD board support"

config GUMSTIX_AM300EPD
	bool "Enable AM300EPD board support"

endchoice

config PXA_SHARPSL_DETECT_MACH_ID
	bool "Detect machine ID at run-time in the decompressor"
	depends on PXA_SHARPSL
	help
	  Say Y here if you want the zImage decompressor to detect
	  the Zaurus machine ID at run-time. For latest kexec-based
	  boot loader, this is not necessary.

config MACH_AKITA
	bool "Enable Sharp SL-1000 (Akita) Support"
	depends on PXA_SHARPSL
	select I2C
	select I2C_PXA
	select MACH_SPITZ
	select PXA27x
	select PXA_SHARP_Cxx00

config MACH_SPITZ
	bool "Enable Sharp Zaurus SL-3000 (Spitz) Support"
	depends on PXA_SHARPSL
	select PXA27x
	select PXA_SHARP_Cxx00

config MACH_BORZOI
	bool "Enable Sharp Zaurus SL-3100 (Borzoi) Support"
	depends on PXA_SHARPSL
	select PXA27x
	select PXA_SHARP_Cxx00

endif # ATAGS

config SHARP_SL_C860_DT_SPI
	bool "Describe the SL-C860 SPI devices in Device Tree"
	depends on MACH_SHARP_SL_C860_DT
	depends on SPI_PXA2XX
	depends on TOUCHSCREEN_ADS7846
	depends on LCD_CORGI
	depends on SENSORS_MAX1111
	help
	  Transfer the PXA25x SSP controller, ADS7846 touchscreen, Sharp LCD
	  timing/backlight controller, and MAX1111 ADC from Corgi-family board
	  tables to Device Tree. The board bridge continues to install the
	  qualified pin multiplexing until native PXA pinctrl ownership moves.

config SHARP_SL_C860_DT_W100
	bool "Describe the SL-C860 W100 display controller in Device Tree"
	depends on MACH_SHARP_SL_C860_DT
	depends on FB_W100
	help
	  Build the SL-C860 W100 framebuffer's Device Tree match data. The
	  pure-DT machine has no legacy platform-device fallback, while pin
	  multiplexing remains in the temporary machine bridge until native PXA
	  pinctrl ownership moves.

config SHARP_SL_C860_DT_KEYBOARD
	bool "Describe the SL-C860 matrix keyboard in Device Tree"
	depends on MACH_SHARP_SL_C860_DT
	depends on SHARP_SL_C860_DT_W100
	depends on KEYBOARD_MATRIX
	help
	  Build the SL-C860 8x12 matrix keyboard and its sparse Fn layer from
	  Device Tree. The pure-DT machine has no legacy platform-device fallback.

config SHARP_SL_C860_DT_PM
	bool "Describe the SL-C860 PM and battery GPIOs in Device Tree"
	depends on MACH_SHARP_SL_C860_DT
	depends on SHARP_SL_C860_DT_KEYBOARD
	depends on SHARPSL_PM
	help
	  Transfer the SL-C860 PM and battery GPIO consumers to a Device Tree
	  instantiated SharpSL PM device. The established suspend and battery
	  algorithms remain intact, but their GPIOs are acquired through
	  descriptors instead of a board-allocated platform device.

	  Charging is deliberately fail-closed in this mode. The Device Tree must
	  declare sharp,charging-disabled; electrical charging qualification is a
	  separate hardware gate.

config SHARP_SL_C860_DT_MMC
	bool "Describe the SL-C860 SD/MMC slot in Device Tree"
	depends on MACH_SHARP_SL_C860_DT
	depends on SHARP_SL_C860_DT_PM
	depends on MMC_PXA
	select REGULATOR_FIXED_VOLTAGE
	help
	  Build the SL-C860 SD/MMC host from Device Tree, including standard
	  card-detect, write-protect, and fixed-regulator slot-power consumers.
	  The pure-DT machine has no legacy platform-device fallback.

config SHARP_SL_C860_DT_UDC
	bool "Describe the SL-C860 USB device controller in Device Tree"
	depends on MACH_SHARP_SL_C860_DT
	depends on SHARP_SL_C860_DT_MMC
	depends on USB_PXA25X
	help
	  Build the PXA25x USB device controller and its D+ pull-up GPIO from
	  Device Tree. The pure-DT machine has no legacy platform-device
	  fallback.

config SHARP_SL_C860_DT_FICP
	bool "Describe the SL-C860 infrared controller in Device Tree"
	depends on MACH_SHARP_SL_C860_DT
	depends on SHARP_SL_C860_DT_UDC
	depends on PXA2XX_FICP_DIAG
	default y
	help
	  Enable the Device Tree instantiated PXA25x infrared diagnostic and
	  its descriptor-based external transceiver power-down control.

config SHARP_SL_C860_DT_AUDIO
	bool "Describe the SL-C860 audio subsystem in Device Tree"
	depends on MACH_SHARP_SL_C860_DT
	depends on SHARP_SL_C860_DT_FICP
	depends on I2C_PXA
	depends on SND_PXA2XX_SOC_CORGI
	default y
	help
	  Enable the Device Tree instantiated PXA25x I2S controller, WM8731
	  codec, and Corgi sound card with SCOOP-backed control GPIOs.

config PXA25x
	bool
	select CPU_XSCALE
	help
	  Select code specific to PXA21x/25x/26x variants

config PXA27x
	bool
	select CPU_XSCALE
	help
	  Select code specific to PXA27x variants

config PXA3xx
	bool
	select CPU_XSC3
	help
	  Select code specific to PXA3xx variants

config CPU_PXA300
	bool
	select PXA3xx
	help
	  PXA300 (codename Monahans-L)

config CPU_PXA310
	bool
	select CPU_PXA300
	help
	  PXA310 (codename Monahans-LV)

config CPU_PXA320
	bool
	select PXA3xx
	help
	  PXA320 (codename Monahans-P)

config PXA_SHARP_Cxx00
	bool
	select SHARPSL_PM
	help
	  Enable common support for Sharp Cxx00 models

config SHARPSL_PM
	bool
	select APM_EMULATION
	select SHARPSL_PM_MAX1111

config SHARPSL_PM_MAX1111
	bool
	select HWMON
	select SENSORS_MAX1111
	select SPI
	select SPI_MASTER

endif
```
